## kernel/delta/Documentation/devicetree/bindings/leds/awinic,aw9524-leds.yaml
```yaml
# SPDX-License-Identifier: (GPL-2.0-only OR BSD-2-Clause)
%YAML 1.2
---
$id: http://devicetree.org/schemas/leds/awinic,aw9524-leds.yaml#
$schema: http://devicetree.org/meta-schemas/core.yaml#

title: Awinic AW9524 current-sink LEDs

maintainers:
  - atzero <atzandrew@gmail.com>

description: |
  AW9524 LED controller on the Cosmo Communicator. Pin indices 0..7
  correspond to P0_0..7 and 8..15 to P1_0..7. All channels start off.
  The chip uses quarter-scale global current as in the stock driver.

properties:
  compatible:
    const: awinic,aw9524-leds
  reg:
    maxItems: 1
  reset-gpios:
    maxItems: 1
    description: Active-low hardware enable/reset line.
  '#address-cells':
    const: 1
  '#size-cells':
    const: 0

patternProperties:
  '^led@[0-9a-f]$':
    type: object
    $ref: common.yaml#
    unevaluatedProperties: false
    properties:
      reg:
        minimum: 0
        maximum: 15
      default-state:
        const: "off"
      max-brightness:
        minimum: 1
        maximum: 255
    required:
      - reg
      - max-brightness

required:
  - compatible
  - reg
  - reset-gpios
  - '#address-cells'
  - '#size-cells'

additionalProperties: false

examples:
  - |
    #include <dt-bindings/gpio/gpio.h>
    i2c {
        #address-cells = <1>;
        #size-cells = <0>;
        led-controller@5b {
            compatible = "awinic,aw9524-leds";
            reg = <0x5b>;
            reset-gpios = <&pio 109 GPIO_ACTIVE_LOW>;
            #address-cells = <1>;
            #size-cells = <0>;
            led@0 {
                reg = <0>;
                label = "cosmo:aw9524:p0-0";
                max-brightness = <64>;
            };
        };
    };
```

## kernel/delta/Documentation/devicetree/bindings/leds/planet,cosmo-kbd-backlight.yaml
```yaml
# SPDX-License-Identifier: (GPL-2.0-only OR BSD-2-Clause)
%YAML 1.2
---
$id: http://devicetree.org/schemas/leds/planet,cosmo-kbd-backlight.yaml#
$schema: http://devicetree.org/meta-schemas/core.yaml#

title: Planet Cosmo Communicator keyboard backlight

maintainers:
  - atzero <atzandrew@gmail.com>

description: |
  The Cosmo uses MT6771 PWM1 in FIFO mode and a 5 V rail (GPIO178)
  shared with HDMI and the right USB-C port, provided as a regulator by
  planet,cosmo-fusb301a. This device owns the entire general PWM register resource;
  it must replace the generic PWM provider, never coexist with it.
  Only channel 1 is programmed. The rail is enabled for keyboard on;
  keyboard off only releases it if HDMI detect GPIO54 is low.

properties:
  compatible:
    const: planet,cosmo-kbd-backlight

  reg:
    maxItems: 1

  clocks:
    minItems: 6
    maxItems: 6

  clock-names:
    items:
      - const: top
      - const: main
      - const: pwm1
      - const: pwm2
      - const: pwm3
      - const: pwm4

  power-supply:
    description: Shared 5 V rail (keyboard, HDMI, right USB-C VBUS).

  hdmi-detect-gpios:
    maxItems: 1
    description: Active high HDMI detection; never drop enable while high.

  pinctrl-names:
    const: default

  pinctrl-0: true

required:
  - compatible
  - reg
  - clocks
  - clock-names
  - power-supply
  - hdmi-detect-gpios
  - pinctrl-names
  - pinctrl-0

additionalProperties: false
```

## kernel/delta/Documentation/devicetree/bindings/usb/planet,cosmo-fusb301a.yaml
```yaml
# SPDX-License-Identifier: (GPL-2.0-only OR BSD-2-Clause)
%YAML 1.2
---
$id: http://devicetree.org/schemas/usb/planet,cosmo-fusb301a.yaml#
$schema: http://devicetree.org/meta-schemas/core.yaml#

title: Planet Cosmo Communicator right USB-C port (FUSB301A)

maintainers:
  - atzero <atzandrew@gmail.com>

description: |
  FUSB301A CC logic for the right USB-C port. One SSUSB controller serves
  both ports; a mux GPIO routes USB 2 data (and the right VBUS switch) to
  the right port. On a sink attach the driver enables the shared 5 V rail,
  sets the mux and selects the host role; a source attach forces the rail
  off. The device provides two regulators: right-vbus (the shared 5 V
  rail, used by the keyboard backlight) and left-vbus (the SSUSB VBUS
  supply, passed through to left-vbus-supply unless the right port is
  the host).

properties:
  compatible:
    const: planet,cosmo-fusb301a

  reg:
    maxItems: 1

  interrupts:
    maxItems: 1
    description: FUSB301A ID output (low while attached as source).

  pinctrl-names:
    const: default

  pinctrl-0: true

  mux-gpios:
    maxItems: 1
    description: High routes USB 2 data and VBUS to the right port.

  vbus-gpios:
    maxItems: 1
    description: Shared 5 V rail enable (keyboard backlight, right VBUS).

  left-vbus-supply:
    description: Left port OTG VBUS source.

  usb-role-switch:
    $ref: /schemas/types.yaml#/definitions/phandle
    description: The SSUSB controller's role switch.

  regulators:
    type: object
    additionalProperties: false
    patternProperties:
      "^(right|left)-vbus$":
        type: object
        $ref: /schemas/regulator/regulator.yaml#
        unevaluatedProperties: false

required:
  - compatible
  - reg
  - mux-gpios
  - vbus-gpios
  - left-vbus-supply
  - usb-role-switch
  - regulators

additionalProperties: false
```

## kernel/delta/drivers/soc/mediatek/Kconfig
```kconfig
# SPDX-License-Identifier: GPL-2.0-only
#
# MediaTek SoC drivers
#
menu "MediaTek SoC drivers"
	depends on ARCH_MEDIATEK || COMPILE_TEST

config MTK_CMDQ
	tristate "MediaTek CMDQ Support"
	depends on ARCH_MEDIATEK || COMPILE_TEST
	select MAILBOX
	select MTK_CMDQ_MBOX
	select MTK_INFRACFG
	help
	  Say yes here to add support for the MediaTek Command Queue (CMDQ)
	  driver. The CMDQ is used to help read/write registers with critical
	  time limitation, such as updating display configuration during the
	  vblank.

config MTK_DEVAPC
	tristate "Mediatek Device APC Support"
	help
	  Say yes here to enable support for Mediatek Device APC driver.
	  This driver is mainly used to handle the violation which catches
	  unexpected transaction.
	  The violation information is logged for further analysis or
	  countermeasures.

config MTK_DVFSRC
	tristate "MediaTek DVFSRC Support"
	depends on ARCH_MEDIATEK
	help
	  Say yes here to add support for the MediaTek Dynamic Voltage
	  and Frequency Scaling Resource Collector (DVFSRC): a HW
	  IP found on many MediaTek SoCs, which is responsible for
	  collecting DVFS requests from various SoC IPs, other than
	  software, and performing bandwidth scaling to provide the
	  best achievable performance-per-watt.

config MTK_INFRACFG
	bool "MediaTek INFRACFG Support"
	select REGMAP
	help
	  Say yes here to add support for the MediaTek INFRACFG controller. The
	  INFRACFG controller contains various infrastructure registers not
	  directly associated to any device.

config MTK_PMIC_WRAP
	tristate "MediaTek PMIC Wrapper Support"
	depends on RESET_CONTROLLER
	depends on OF
	select REGMAP
	help
	  Say yes here to add support for MediaTek PMIC Wrapper found
	  on different MediaTek SoCs. The PMIC wrapper is a proprietary
	  hardware to connect the PMIC.

config MTK_REGULATOR_COUPLER
	bool "MediaTek SoC Regulator Coupler" if COMPILE_TEST
	default ARCH_MEDIATEK
	depends on REGULATOR

config MTK_MMSYS
	tristate "MediaTek MMSYS Support"
	default ARCH_MEDIATEK
	depends on HAS_IOMEM
	depends on MTK_CMDQ || MTK_CMDQ=n
	help
	  Say yes here to add support for the MediaTek Multimedia
	  Subsystem (MMSYS).

config MTK_SVS
	tristate "MediaTek Smart Voltage Scaling(SVS)"
	depends on NVMEM_MTK_EFUSE && NVMEM
	help
	  The Smart Voltage Scaling(SVS) engine is a piece of hardware
	  which has several controllers(banks) for calculating suitable
	  voltage to different power domains(CPU/GPU/CCI) according to
	  chip process corner, temperatures and other factors. Then DVFS
	  driver could apply SVS bank voltage to PMIC/Buck.

config MTK_SOCINFO
	tristate "MediaTek SoC Information"
	default y
	depends on NVMEM_MTK_EFUSE
	select SOC_BUS
	help
	  The MediaTek SoC Information (mtk-socinfo) driver provides
	  information about the SoC to the userspace including the
	  manufacturer name, marketing name and soc name.

config MT6771_CONSYS
	tristate "MediaTek MT6771 CONSYS power-on check"
	depends on OF && HAS_IOMEM && REGULATOR && RESET_CONTROLLER
	help
	  Runs the stock CONSYS (on-die Wi-Fi/BT) power-on order once at
	  probe, reads the CONSYS chip ID and powers it off again. Bring-up
	  check for the Cosmo Communicator Wi-Fi port; nothing stays on.
	  Superseded by MTK_WCN_CONSYS (same DT node); expects the W1a
	  register layout and is kept for reference.

config MTK_LK_OVERLAY_CLEAR
	bool "Clear the MediaTek LK overlay layer at boot"
	depends on OF && HAS_IOMEM
	help
	  MediaTek LK can leave extra display overlay layers enabled when it
	  starts the kernel, with bootloader text (such as the unlocked
	  "orange state" warning) drawn above the framebuffer the kernel
	  console uses. This driver fills each "mediatek,lk-overlay-clear"
	  buffer with transparent pixels once at boot. It writes memory only;
	  no display register is touched.

config COSMO_SLEEP_GUARD
	bool "Cosmo Communicator: refuse sleep while the panel bias is on"
	depends on OF && PM_SLEEP && REGULATOR
	help
	  Reads the MT6370 display bias rails (DSVPOS/DSVNEG) in the device
	  suspend phase, after DRM has switched the panel off, and fails the
	  suspend if either is still on or cannot be read. Until the driver
	  has probed, every suspend is refused. Read-only.

endmenu
```
